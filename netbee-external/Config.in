## netbee-external/Config.in
```kconfig
menu "NetBee OS Packages"
source "$BR2_EXTERNAL_NETBEE_PATH/package/adguardhome/Config.in"
source "$BR2_EXTERNAL_NETBEE_PATH/package/netbeed/Config.in"
endmenu
```

## netbee-external/configs/netbee_rpi5_defconfig
```kconfig
# NetBee OS - Raspberry Pi 5 Home Firewall & Router Defconfig
# Architecture & CPU
BR2_aarch64=y
BR2_cortex_a76=y

# External Bootlin Toolchain (fast builds, glibc stable)
BR2_TOOLCHAIN_EXTERNAL=y
BR2_TOOLCHAIN_EXTERNAL_BOOTLIN=y
BR2_TOOLCHAIN_EXTERNAL_BOOTLIN_AARCH64_GLIBC_STABLE=y

# Build & System Configuration
BR2_PER_PACKAGE_DIRECTORIES=y
BR2_GLOBAL_PATCH_DIR="board/raspberrypi/patches"
BR2_DOWNLOAD_FORCE_CHECK_HASHES=y
BR2_ROOTFS_DEVICE_CREATION_DYNAMIC_EUDEV=y
# BR2_PACKAGE_EUDEV_ENABLE_HWDB is not set
BR2_TARGET_GENERIC_HOSTNAME="netbee"
BR2_TARGET_GENERIC_ISSUE="Welcome to NetBee OS"
BR2_TARGET_GENERIC_PASSWD_SHA512=y
BR2_TARGET_GENERIC_ROOT_PASSWD="netbee"
BR2_SYSTEM_DHCP=""
BR2_TARGET_TZ_INFO=y
BR2_TARGET_TZ_ZONELIST="etcetera europe"
BR2_TARGET_LOCALTIME="Europe/Istanbul"
BR2_ROOTFS_USERS_TABLES="$(BR2_EXTERNAL_NETBEE_PATH)/board/netbee/rpi5/users.table"
BR2_ROOTFS_DEVICE_TABLE="system/device_table.txt $(BR2_EXTERNAL_NETBEE_PATH)/board/netbee/rpi5/device_table.txt"
BR2_ROOTFS_OVERLAY="$(BR2_EXTERNAL_NETBEE_PATH)/board/netbee/rpi5/rootfs-overlay"
BR2_ROOTFS_POST_BUILD_SCRIPT="board/raspberrypi5/post-build.sh $(BR2_EXTERNAL_NETBEE_PATH)/board/netbee/rpi5/post-build.sh"
BR2_ROOTFS_POST_IMAGE_SCRIPT="board/raspberrypi5/post-image.sh"

# Linux Kernel (Raspberry Pi 5 + NetBee Router Fragment)
BR2_LINUX_KERNEL=y
BR2_LINUX_KERNEL_CUSTOM_TARBALL=y
BR2_LINUX_KERNEL_CUSTOM_TARBALL_LOCATION="$(call github,raspberrypi,linux,21b410140c47ffab5668399f6f143c7d7b935c8b)/linux-21b410140c47ffab5668399f6f143c7d7b935c8b.tar.gz"
BR2_LINUX_KERNEL_DEFCONFIG="bcm2712"
BR2_LINUX_KERNEL_CONFIG_FRAGMENT_FILES="board/raspberrypi/linux-4k-page-size.fragment $(BR2_EXTERNAL_NETBEE_PATH)/board/netbee/rpi5/linux-netbee.fragment"
BR2_LINUX_KERNEL_DTS_SUPPORT=y
BR2_LINUX_KERNEL_INTREE_DTS_NAME="broadcom/bcm2712-rpi-5-b broadcom/bcm2712d0-rpi-5-b broadcom/bcm2712-rpi-500"
BR2_LINUX_KERNEL_NEEDS_HOST_OPENSSL=y

# BusyBox & Base System
BR2_PACKAGE_BUSYBOX_CONFIG_FRAGMENT_FILES="$(BR2_EXTERNAL_NETBEE_PATH)/board/netbee/rpi5/busybox-netbee.fragment"
BR2_PACKAGE_BUSYBOX_SHOW_OTHERS=y
BR2_PACKAGE_XZ=y
BR2_PACKAGE_KMOD=y
BR2_PACKAGE_KMOD_TOOLS=y
BR2_PACKAGE_E2FSPROGS=y
BR2_PACKAGE_E2FSPROGS_RESIZE2FS=y
BR2_PACKAGE_UTIL_LINUX=y
BR2_PACKAGE_UTIL_LINUX_BINARIES=y
BR2_PACKAGE_UTIL_LINUX_PARTX=y
BR2_PACKAGE_CA_CERTIFICATES=y
BR2_PACKAGE_LOGROTATE=y
BR2_PACKAGE_LIBSECCOMP=y
BR2_PACKAGE_SQLITE=y
BR2_PACKAGE_TRIGGERHAPPY=y

# OpenSSL Hardening (Disable legacy & weak ciphers/protocols)
# BR2_PACKAGE_LIBOPENSSL_ENABLE_SSL3 is not set
# BR2_PACKAGE_LIBOPENSSL_ENABLE_WEAK_SSL is not set
# BR2_PACKAGE_LIBOPENSSL_UNSECURE is not set
# BR2_PACKAGE_LIBOPENSSL_ENABLE_RC2 is not set
# BR2_PACKAGE_LIBOPENSSL_ENABLE_RC4 is not set
# BR2_PACKAGE_LIBOPENSSL_ENABLE_MD2 is not set
# BR2_PACKAGE_LIBOPENSSL_ENABLE_MD4 is not set
# BR2_PACKAGE_LIBOPENSSL_ENABLE_MDC2 is not set
# BR2_PACKAGE_LIBOPENSSL_ENABLE_BLOWFISH is not set
# BR2_PACKAGE_LIBOPENSSL_ENABLE_IDEA is not set
# BR2_PACKAGE_LIBOPENSSL_ENABLE_CAST is not set
# BR2_PACKAGE_LIBOPENSSL_ENABLE_SEED is not set
# BR2_PACKAGE_LIBOPENSSL_ENABLE_WHIRLPOOL is not set

# Raspberry Pi 5 Firmware
BR2_PACKAGE_RPI_FIRMWARE=y
BR2_PACKAGE_RPI_FIRMWARE_CONFIG_FILE="$(BR2_EXTERNAL_NETBEE_PATH)/board/netbee/rpi5/config_5.txt"
BR2_PACKAGE_RPI_FIRMWARE_CMDLINE_FILE="board/raspberrypi5/cmdline_5.txt"
BR2_PACKAGE_RPI_FIRMWARE_INSTALL_DTB_OVERLAYS=y

# Core Router, Firewall, VPN, DNS/DHCP & PPPoE Packages
BR2_PACKAGE_NFTABLES=y
BR2_PACKAGE_NFTABLES_JSON=y
BR2_PACKAGE_CONNTRACK_TOOLS=y
BR2_PACKAGE_ADGUARDHOME=y
BR2_PACKAGE_NETBEED=y
BR2_PACKAGE_DROPBEAR=y
# BR2_PACKAGE_DROPBEAR_CLIENT is not set
BR2_PACKAGE_PPPD=y
BR2_PACKAGE_RP_PPPOE=y
BR2_PACKAGE_DHCPCD=y
BR2_PACKAGE_RADVD=y
BR2_PACKAGE_WIREGUARD_TOOLS=y
BR2_PACKAGE_IPROUTE2=y
BR2_PACKAGE_ETHTOOL=y
# BR2_PACKAGE_ETHTOOL_PRETTY_PRINT is not set
BR2_PACKAGE_CHRONY=y

# Network Diagnostics, Traffic Monitoring & Benchmarking
BR2_PACKAGE_JANSSON=y
BR2_PACKAGE_TCPDUMP=y
BR2_PACKAGE_IPERF3=y
BR2_PACKAGE_VNSTAT=y
BR2_PACKAGE_MTR=y

# Rootfs & SD Card Image
BR2_TARGET_ROOTFS_EXT2=y
BR2_TARGET_ROOTFS_EXT2_4=y
BR2_TARGET_ROOTFS_EXT2_SIZE="192M"
BR2_TARGET_ROOTFS_EXT2_MKFS_OPTIONS="-b 4096 -O ^64bit"
# BR2_TARGET_ROOTFS_TAR is not set
BR2_PACKAGE_HOST_DOSFSTOOLS=y
BR2_PACKAGE_HOST_GENIMAGE=y
BR2_PACKAGE_HOST_KMOD_XZ=y
BR2_PACKAGE_HOST_MTOOLS=y
```

## netbee-external/package/adguardhome/Config.in
```kconfig
config BR2_PACKAGE_ADGUARDHOME
	bool "adguardhome"
	depends on BR2_aarch64
	help
	  AdGuard Home is a network-wide software for blocking ads,
	  tracking, and malicious domains (DNS + optional DHCP server).

	  https://github.com/AdguardTeam/AdGuardHome
```

## netbee-external/package/netbeed/Config.in
```kconfig
config BR2_PACKAGE_NETBEED
	bool "netbeed"
	depends on BR2_PACKAGE_HOST_GO_TARGET_ARCH_SUPPORTS
	help
	  NetBee OS lightweight router & firewall management API daemon.
	  Exposes a secure HTTPS REST/SSE API for all router subsystems
	  (network, WAN/PPPoE/ONT, nftables, AdGuardHome, WireGuard, SQM,
	  vnStat, NTP, IPv6, SSH, diagnostics, logs, and backup/restore)
	  and serves a user-supplied static web frontend from /usr/share/netbee/web.
```
